#include <Arduino.h>
#include <Wire.h>
#include "RP2040_PWM.h"
#include <Temperature_LM75_Derived.h>

#define BOARDID "red-70-single-long"
#define N_PWM_PINS 7
#define FREQUENCY 10000
#define STATUS_PIN 7
uint8_t pwm_pins[] = {0,1,2, 3, 4, 5, 6};
RP2040_PWM* PWM_Instance[N_PWM_PINS];

// The Generic_LM75 class will provide 9-bit (±0.5°C) temperature for any
// LM75-derived sensor. More specific classes may provide better resolution.
Generic_LM75* temperature_sensors[7];

double read_channel_current(uint8_t channel, unsigned long count);

struct Action
{
  uint32_t time;
  uint8_t channel;
  uint8_t intensity;
};

unsigned long long start_time;

bool status_pin = false;
bool heat_disabled = false;

uint16_t current_action = 0;

struct Action actions_sweep[] = {
    {10, 0, 0},
    {10, 0, 1},
    {10, 0, 2},
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    {40, 6, 0},
{UINT32_MAX, 0, 0} //END of programme
};

struct Action actions_use[] = {
    {30, 0, 0},
    {30, 1, 0},
    {30, 2, 40},
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    {1410, 6, 0},
    {UINT32_MAX, 0, 0} //END of programme
};

struct Action actions[] = {
    {0, 0, 0},
    {3, 0, 0},
    {3, 0, 1},
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    {123, 0, 0},
{UINT32_MAX, 0, 0} //END of programme
};

void toggle_status_led()
{
  if (status_pin)
    digitalWrite(STATUS_PIN, LOW);
  else
    digitalWrite(STATUS_PIN, HIGH);

  status_pin = !status_pin;
}

void set_channel_slow(uint8_t channel, double intensity)
{
  analogWrite(pwm_pins[channel], (int) intensity/100.0*255);
}

double read_channel_current(uint8_t channel)
{
  return read_channel_current(channel, 4000);
}

double read_channel_current(uint8_t channel, unsigned long count)
{
  //configure the mux
  
  digitalWrite(13, (channel & 1 == 1 ) ? HIGH : LOW); //LSB
  digitalWrite(12, ((channel >> 1) & 1 == 1) ? HIGH : LOW);
  digitalWrite(11, ((channel >> 2) & 1 == 1) ? HIGH : LOW);

  delay(1);

  unsigned long sum = 0;

  for (int i = 0; i<count; i++)
  {
    sum += analogRead(26);
  }

  return sum/count;// * 3300/count / ( (1 << 12) - 1);
}

void set_channel(uint8_t channel, double intensity)
{
  if (intensity < 0.1)
    intensity = 0; //correct double issues

  PWM_Instance[channel]->setPWM(pwm_pins[channel], FREQUENCY, intensity, false);
  PWM_Instance[channel]->enablePWM();
}

bool print_all_temps()
{
  bool overheat = false;
  float temp;
  for (int i = 0; i<7; i++)
  {
    /**
     * This doesn't work. It make no sense. Passing it to print works, storing it in a variable doesnt
     * To make it more fun, it works the first time the function gets called. On later calls it keeps printing 
     * the first temperature from the first sensor. WTF 
     */ 
    //temp = temperature_sensors[i]->readTemperatureC();
    Serial.print(temperature_sensors[i]->readTemperatureC());
    Serial.print(" ");

//  seems the pi god is against overheat protection (see above)
//    if (overheat || temp > 100)
//      overheat = true;
  }

  return overheat;
}

void setup_fast_pwm()
{
  Serial.println("Setting up PWM");
  for (int i=0; i < N_PWM_PINS; i++)
  {
    pinMode(pwm_pins[i], OUTPUT);
    PWM_Instance[i] = new RP2040_PWM(pwm_pins[i], FREQUENCY, 0);
    set_channel(i, 0);
  }
}


void current_measurement_counts()
{
  set_channel(0, 10);
  Serial.println("#Intensity 10%\n");
  for(long l=1; l<2000; l+=20)
  {
    Serial.print(millis());
    Serial.print(" ");
    Serial.print(l);
    Serial.print(" ");
    for (long i=0; i<1000; i++)
    {
      Serial.print(read_channel_current(0, l));
      Serial.print(" ");
    }
    Serial.print(millis());

    Serial.println();
  }
  set_channel(0, 0);
}

void setup()
{
  Serial.begin(115200);
  while(!Serial);
  arduino::MbedI2C temperature_wire(p20, p21);
  temperature_wire.begin();
  analogReadResolution(12);
  Serial.println("#Init serial");
  Serial.println("#Intialising temperature sensors");
  for (uint8_t i = 0; i<7; i++)
  {
    Serial.println("#Initialising sensor");
    temperature_sensors[i] = new Generic_LM75(&temperature_wire, 0x48+i);
  }
  setup_fast_pwm();
  //current_measurement_counts();
  //return;
  print_all_temps();
  Serial.println("#Setup done");
  Serial.print("#Running program on ");
  Serial.println(BOARDID);
  Serial.println("time T1 T2 T3 T4 T5 T6 Tcore C1 C2 C3 C4 C5 C6 time");
  start_time = millis();

  pinMode(STATUS_PIN, OUTPUT);

  //fast flash indicates programme start
  for (int i = 0; i<10; i++)
  {
    toggle_status_led();
    delay(100);
  }
}

double duty = 0;
int8_t dir = 1;
double step = 0.1;


void loop()
{
  //Serial.print("");
  Serial.print(millis());
  Serial.print(" ");
  if (print_all_temps())
  {
    Serial.println("#OVERHEAT DETECTED, HEATING DISABLED UNTIL RESET!");
    heat_disabled = true;
    set_channel(6, 0);
  }

  for (int i = 0; i<N_PWM_PINS; i++)
  {
    Serial.print(read_channel_current(i));
    Serial.print(" ");
  }

  Serial.println(millis());
  //return;
  while (actions[current_action].time < (millis() - start_time)/1000)
  {
    toggle_status_led();
    if (actions[current_action].channel == 6 && heat_disabled)
    {
      Serial.println("#HEATING DISABLED");
      current_action++;
    }

    set_channel(actions[current_action].channel, actions[current_action].intensity);
    Serial.print("#");
    Serial.print(millis());
    Serial.print(" channel: ");
    Serial.print(actions[current_action].channel);
    Serial.print(" intensity: ");
    Serial.print(actions[current_action].intensity);
    Serial.print(" ");
    Serial.print(" current: ");
    Serial.println(read_channel_current(actions[current_action].channel));
    current_action++;
    toggle_status_led();//fast flash LED [might not be visible]
  }
  if (actions[current_action].time != UINT32_MAX)
    toggle_status_led();
  //delay(100);
}